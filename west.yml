## west.yml
```yaml
manifest:
  remotes:
    - name: zephyrproject-rtos
      url-base: https://github.com/zephyrproject-rtos
  defaults:
    remote: zephyrproject
  projects:
    - name: zephyr
      remote: zephyrproject
      revision: main
      import: true
```
